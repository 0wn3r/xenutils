## west.yml
```yaml
# SPDX-License-Identifier: Apache-2.0
# West yml manifest for Zephyr dom0 demo

manifest:
  self:
    path: .

  remotes:
    - name: firscity_zephyr_dom0
      url-base: https://github.com/0wn3r/

  projects:
    - name: zephyr_dom0
      remote: firscity_zephyr_dom0
      repo-path: zephyr.git
      revision: kernel_devel_rebase2
      west-commands: scripts/west-commands.yml
```
